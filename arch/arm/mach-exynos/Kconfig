## arch/arm/mach-exynos/Kconfig
```kconfig
# arch/arm/mach-exynos/Kconfig
#
# Copyright (c) 2010-2011 Samsung Electronics Co., Ltd.
#		http://www.samsung.com/
#
# Licensed under GPLv2

# Configuration options for the EXYNOS

if ARCH_EXYNOS

choice
	prompt "EXYNOS system type"
	default ARCH_EXYNOS4

config ARCH_EXYNOS4
	bool "Samsung Exynos4"
	select ARM_ERRATA_743622
	select ARM_ERRATA_751472 if SMP
	select ARM_ERRATA_754322
	select ARM_ERRATA_764369 if SMP
	help
	  Samsung EXYNOS4 series based systems

config ARCH_EXYNOS5
	bool "Samsung Exynos5"
	select ARM_ERRATA_761171
	select ARM_ERRATA_762974
	select ARM_ERRATA_763722
	help
	  Samsung EXYNOS5 series based systems

endchoice

config CPU_EXYNOS4210
	bool
	select S3C_PL330_DMA
	select PL310_ERRATA_727915
	select ARM_ERRATA_753970
	help
	  Enable EXYNOS4210 CPU support

config CPU_EXYNOS4212
	bool
	select S3C_PL330_DMA
	help
	  Enable EXYNOS4212 CPU support

config CPU_EXYNOS4412
	bool
	select S3C_PL330_DMA
	select ARM_ERRATA_761320 if SMP
	help
	  Enable EXYNOS4412 CPU support

config CPU_EXYNOS5210
	bool
	select S3C_PL330_DMA
	help
	  Enable EXYNOS5210 CPU support

config MX_SERIAL_TYPE
	bool
	select S3C_DEV_HWMON if S3C_ADC
	select S3C_DEV_WDT
	select S3C_DEV_RTC
	select S3C_DEV_HSMMC3
	select S3C_DEV_I2C1
	select S3C_DEV_I2C3
	select S3C_DEV_I2C5
	select S3C_DEV_I2C6
	select S3C_DEV_I2C7
	select S5P_GPIO_INT
	select S5P_DEV_MFC
	select S5P_DEV_FIMG2D
	select S5P_DEV_ROTATOR
	select S5P_DEV_USB_EHCI
	select S5P_DEV_USBGADGET
	select S5P_DEV_DSIM
	select S5P_DEV_FIMD_S5P
	select S5P_DEV_JPEG
	select S5P_DEV_I2C_HDMIPHY
	select EXYNOS_DEV_PD
	select EXYNOS4_DEV_SYSMMU
	select S5P_SETUP_MIPIPHY
	select EXYNOS4_SETUP_SDHCI
	select EXYNOS4_SETUP_FB_S5P
	select EXYNOS4_SETUP_MFC
	select EXYNOS4_SETUP_USB_PHY
	select EXYNOS4_SETUP_I2C1
	select EXYNOS4_SETUP_I2C3
	select EXYNOS4_SETUP_I2C5
	select EXYNOS4_SETUP_I2C6
	select EXYNOS4_SETUP_I2C7
	select SAMSUNG_DEV_ADC
	select SAMSUNG_DEV_BACKLIGHT
	select SAMSUNG_DEV_PWM
	select EXYNOS4_DEV_PPMU
	help
	  Enable Meizu M030/M031/M032 Platform support
	
choice
	prompt "EXYNOS5210 core type"
	depends on CPU_EXYNOS5210
	default CPU_A15

config CPU_EXYNOS5210_A15
	bool "A15 core"
	help
	  A15 dual core CPU support

config CPU_EXYNOS5210_A5_IOP
	bool "A5 IOP core"
	help
	  A5 single core CPU support
endchoice

config CPU_EXYNOS5250
	bool
	select S3C_PL330_DMA
	help
	  Enable EXYNOS5250 CPU support

config EXYNOS4_CONTENT_PATH_PROTECTION
	bool "Exynos4 Content Path Protection"
	depends on ARM_TRUSTZONE
	default n
	help
	  Enable content path protection of EXYNOS4.

config EXYNOS4_PM
	bool "Exynos4 Power Management"
	depends on (PM && ARCH_EXYNOS4)
	default y
	help
	  Enable suspend and resume for Exynos4 series.

config EXYNOS5_PM
	bool "Exynos5 Power Management"
	depends on (PM && ARCH_EXYNOS5)
	default y
	help
	  Enable suspend and resume for Exynos5 series.

config EXYNOS4_CPUIDLE
	bool "Exynos4 CPUIDLE Feature"
	depends on (CPU_IDLE && ARCH_EXYNOS4)
	default y
	help
	  Enable CPUIDLE for Exynos4 series.

config EXYNOS4_LOWPWR_IDLE
	bool "Exynos4 Lowpower IDLE Feature"
	depends on EXYNOS4_CPUIDLE
	default y
	help
	  Enable Low power IDLE for Exynos4 series.

config EXYNOS5_CPUIDLE
	bool "Exynos5 CPUIDLE Feature"
	depends on (CPU_IDLE && ARCH_EXYNOS5)
	default y
	help
	  Enable CPUIDLE for Exynos5 series.

config EXYNOS_MCT
	bool
	default y
	help
	  Use MCT (Multi Core Timer) as kernel timers

config EXYNOS5_DEV_AHCI
	bool
	help
	  Compile in platform device definitions for AHCI SATA3.0

config EXYNOS4_DEV_AHCI
	bool
	help
	  Compile in platform device definitions for AHCI

config EXYNOS4_SETUP_FIMD0
	bool
	help
	  Common setup code for FIMD0.

config EXYNOS4_SETUP_FIMD
	bool
	help
	  Common setup code for FIMD.

config EXYNOS4_SETUP_DP
	bool
	help
	  Common setup code for DP.

config EXYNOS_DEV_PD
	bool
	help
	  Compile in platform device definitions for Power Domain

config EXYNOS_DEV_CPUFREQ
	bool
	default y
	depends on EXYNOS_CPUFREQ
	help
	 EXYNOS CPU Freq platform

config EXYNOS_DEV_BUSFREQ
	bool
	default y
	depends on EXYNOS4_BUS_DEVFREQ
	help
	 EXYNOS BUS devfreq

config EXYNOS4_DEV_SYSMMU
	bool
	help
	  Common setup code for SYSTEM MMU in EXYNOS4
 
config EXYNOS4_DEV_PPMU
	bool
	help
	  Compile in platform device definitions for PPMU

config EXYNOS4_DEV_FIMC_LITE
	bool
	help
	  Compile in platform device definitions for FIMC_LITE

config EXYNOS4_DEV_FIMC_IS
	bool
	depends on (VIDEO_EXYNOS_FIMC_IS || VIDEO_EXYNOS5_FIMC_IS)
	default y
	help
	  Compile in platform device definition for FIMC-IS

config EXYNOS4_SETUP_I2C1
	bool
	help
	  Common setup code for i2c bus 1.

config EXYNOS4_SETUP_I2C2
	bool
	help
	  Common setup code for i2c bus 2.

config EXYNOS4_SETUP_I2C3
	bool
	help
	  Common setup code for i2c bus 3.

config EXYNOS4_SETUP_I2C4
	bool
	help
	  Common setup code for i2c bus 4.

config EXYNOS4_SETUP_I2C5
	bool
	help
	  Common setup code for i2c bus 5.

config EXYNOS4_SETUP_I2C6
	bool
	help
	  Common setup code for i2c bus 6.

config EXYNOS4_SETUP_I2C7
	bool
	help
	  Common setup code for i2c bus 7.

config EXYNOS4_SETUP_KEYPAD
	bool
	help
	  Common setup code for keypad.

config EXYNOS4_SETUP_MFC
	bool
	help
	  Common setup code for MFC.

config EXYNOS4_SETUP_SDHCI
	bool
	select EXYNOS4_SETUP_SDHCI_GPIO
	help
	  Internal helper functions for EXYNOS4 based SDHCI systems.

config EXYNOS4_SETUP_SDHCI_GPIO
	bool
	help
	  Common setup code for SDHCI gpio.

config EXYNOS4_SETUP_MSHCI
	bool
	depends on EXYNOS4_DEV_MSHC
	default y
	select EXYNOS4_SETUP_MSHCI_GPIO
	help
	  Internal helper functions for EXYNOS4 based MSHCI systems.

config EXYNOS4_SETUP_MSHCI_GPIO
	bool
	help
	  Common setup code for MSHCI gpio.

config EXYNOS4_SETUP_FIMC
	bool
	depends on VIDEO_SAMSUNG_S5P_FIMC
	default y
	help
	  Common setup code for the camera interfaces.

config EXYNOS4_SETUP_FIMC0
	bool
	depends on VIDEO_FIMC
	default y
	help
	  Common setup code for the camera interfaces.

config EXYNOS4_SETUP_FIMC1
	bool
	depends on VIDEO_FIMC
	default y
	help
	  Common setup code for the camera interfaces.

config EXYNOS4_SETUP_FIMC2
	bool
	depends on VIDEO_FIMC
	default y
	help
	  Common setup code for the camera interfaces.

config EXYNOS4_SETUP_FIMC3
	bool
	depends on VIDEO_FIMC
	default y
	help
	  Common setup code for the camera interfaces.

config EXYNOS4_SETUP_FIMC_IS
	bool
	depends on (VIDEO_EXYNOS_FIMC_IS || VIDEO_EXYNOS5_FIMC_IS)
	default y
	help
	  Common setup code for the FIMC-IS

config EXYNOS4_SETUP_USB_PHY
	bool
	help
	  Common setup code for USB PHY controller

config EXYNOS4_SETUP_CSIS
	bool
	depends on VIDEO_FIMC_MIPI
	default y
	help
	  Common setup code for MIPI-CSIS

config EXYNOS4_SETUP_FB_S5P
	bool
	default n
	help
	  Setup code for EXYNOS4 FIMD

config EXYNOS4_SETUP_TVOUT
	bool
	default y
	help
	  Common setup code for TVOUT

config EXYNOS_DEV_TMU
	bool
	depends on SENSORS_EXYNOS4_TMU
	default y

config EXYNOS4_SETUP_JPEG
	bool
	depends on VIDEO_JPEG_V2X || VIDEO_JPEG_MX
	default y
	help
	  Common setup code for JPEG

config EXYNOS_FIQ_DEBUGGER
	bool "Exynos FIQ debugger support"
	depends on FIQ_DEBUGGER
	default y
	help
	  Exynos platform support for the FIQ debugger

config EXYNOS5_DEV_GSC
	bool
	depends on VIDEO_EXYNOS_GSCALER
	default y
	help
	  Compile in platform device definitions for GSC

config EXYNOS5_SETUP_GSC
	bool
	depends on VIDEO_EXYNOS_GSCALER
	default y
	help
	  Common setup code for GSC

config EXYNOS4_ENABLE_CLOCK_DOWN
	bool "ARM core clock down feature enable"
	depends on EXYNOS4_CPUIDLE
	default n
	help
	  ARM core clock down in idle time.

config EXYNOS5_ENABLE_CLOCK_DOWN
	bool "ARM core clock down feature enable"
	depends on EXYNOS5_CPUIDLE
	default n
	help
	  ARM core clock down in idle time.

menu "Support dynamic CPU Hotplug"
	depends on HOTPLUG_CPU && SMP

config EXYNOS_PM_HOTPLUG
	bool "EXYNOS Dynamic Hotplug"
	help
	  Dynamic CPU HOTLUG for EXYNOS series

choice
	prompt "Dynamic CPU HOTPLUG Policy"
	depends on EXYNOS_PM_HOTPLUG
	default STAND_ALONE_POLICY

config STAND_ALONE_POLICY
	bool "Stand alone policy CPU hotplug"

config WITH_DVFS_POLICY
	depends on EXYNOS4_CPUFREQ
	bool "Intergrated DVFS CPU hotplug"

config DVFS_NR_RUNNING_POLICY
	depends on (EXYNOS4_CPUFREQ || EXYNOS5_CPUFREQ)
	bool "DVFS-nr_running CPU hotplug"

config NR_RUNNING_POLICY
	bool "nr_running CPU hotplug"

endchoice
endmenu

menu "Busfreq Model"
	depends on EXYNOS_CPUFREQ

config BUSFREQ
	bool "Busfreq with PPC/PPMU"
	depends on EXYNOS_CPUFREQ && !CPU_EXYNOS4212

config BUSFREQ_OPP
	bool "Busfreq with OPP on ARCH_EXYNOS"
	depends on ARCH_EXYNOS4 || ARCH_EXYNOS5

config EXYNOS4210_BUSFREQ_OPP
	bool "Busfreq with OPP on CPU_EXYNOS4210"
	depends on BUSFREQ_OPP && CPU_EXYNOS4210

config EXYNOS4X12_BUSFREQ_OPP
	bool "Busfreq with OPP on CPU_EXYNOS4X12"
	depends on BUSFREQ_OPP && CPU_EXYNOS4212
	
endmenu

# machine support

menu "EXYNOS4 Machines"
	depends on ARCH_EXYNOS4

config MACH_SMDKC210
	bool "SMDKC210"
	select CPU_EXYNOS4210
	select S3C_DEV_RTC
	select S3C_DEV_WDT
	select S3C_DEV_I2C1
	select S3C_DEV_HSMMC2
	select S3C_DEV_HSMMC3
	select S3C_DEV_HWMON if S3C_ADC
	select S5P_GPIO_INT
	select S5P_DEV_FIMD0
	select S5P_DEV_FIMD_S5P
	select S5P_DEV_MFC
	select S5P_DEV_FIMG2D
	select S5P_DEV_USBGADGET
	select S5P_DEV_JPEG
	select S5P_DEV_THERMAL
	select S5P_DEV_USB_EHCI
	select EXYNOS4_DEV_SYSMMU
	select EXYNOS_DEV_PD
	select EXYNOS4_SETUP_FIMD0
	select EXYNOS4_SETUP_I2C1
	select EXYNOS4_SETUP_KEYPAD
	select EXYNOS4_SETUP_SDHCI
	select EXYNOS4_SETUP_FB_S5P
	select EXYNOS4_SETUP_USB_PHY
	select EXYNOS4_SETUP_MFC
	select SAMSUNG_DEV_KEYPAD
	select SAMSUNG_DEV_ADC
	select SAMSUNG_DEV_TS
	select SAMSUNG_DEV_TS1
	select SAMSUNG_DEV_PWM
	select SAMSUNG_DEV_BACKLIGHT
	help
	  Machine support for Samsung SMDKC210

config MACH_SMDKV310
	bool "SMDKV310"
	select CPU_EXYNOS4210
	select S3C_DEV_RTC
	select S3C_DEV_WDT
	select S3C_DEV_I2C1
	select S3C_DEV_HSMMC2
	select S3C_DEV_HSMMC3
	select S3C_DEV_HWMON if S3C_ADC
	select S5P_GPIO_INT
	select S5P_DEV_FIMD0
	select S5P_DEV_FIMD_S5P
	select S5P_DEV_MFC
	select S5P_DEV_FIMG2D
	select S5P_DEV_USBGADGET
	select S5P_DEV_JPEG
	select S5P_DEV_THERMAL
	select S5P_DEV_USB_EHCI
	select EXYNOS4_DEV_SYSMMU
	select EXYNOS_DEV_PD
	select EXYNOS4_SETUP_FIMD0
	select EXYNOS4_SETUP_I2C1
	select EXYNOS4_SETUP_KEYPAD
	select EXYNOS4_SETUP_SDHCI
	select EXYNOS4_SETUP_FB_S5P
	select EXYNOS4_SETUP_USB_PHY
	select EXYNOS4_SETUP_MFC
	select EXYNOS4_DEV_AHCI
	select SAMSUNG_DEV_PWM
	select SAMSUNG_DEV_BACKLIGHT
	select SAMSUNG_DEV_KEYPAD
	select SAMSUNG_DEV_ADC
	select SAMSUNG_DEV_TS
	select SAMSUNG_DEV_TS1
	help
	  Machine support for Samsung SMDKV310

config MACH_ARMLEX4210
	bool "ARMLEX4210"
	select CPU_EXYNOS4210
	select S3C_DEV_RTC
	select S3C_DEV_WDT
	select S3C_DEV_HSMMC
	select S3C_DEV_HSMMC2
	select S3C_DEV_HSMMC3
	select EXYNOS4_DEV_SYSMMU
	select EXYNOS4_DEV_AHCI
	select EXYNOS4_SETUP_SDHCI
	help
	  Machine support for Samsung ARMLEX4210 based on EXYNOS4210

config MACH_UNIVERSAL_C210
	bool "Mobile UNIVERSAL_C210 Board"
	select CPU_EXYNOS4210
	select S3C_DEV_HSMMC
	select S3C_DEV_HSMMC2
	select S3C_DEV_HSMMC3
	select S3C_DEV_I2C1
	select S3C_DEV_I2C5
	select S5P_DEV_ONENAND
	select EXYNOS4_SETUP_I2C1
	select EXYNOS4_SETUP_I2C5
	select EXYNOS4_SETUP_SDHCI
	help
	  Machine support for Samsung Mobile Universal S5PC210 Reference
	  Board.

config MACH_NURI
	bool "Mobile NURI Board"
	select CPU_EXYNOS4210
	select S3C_DEV_WDT
	select S3C_DEV_HSMMC
	select S3C_DEV_HSMMC2
	select S3C_DEV_HSMMC3
	select S3C_DEV_I2C1
	select S3C_DEV_I2C3
	select S3C_DEV_I2C5
	select S5P_DEV_USB_EHCI
	select EXYNOS4_SETUP_I2C1
	select EXYNOS4_SETUP_I2C3
	select EXYNOS4_SETUP_I2C5
	select EXYNOS4_SETUP_SDHCI
	select EXYNOS4_SETUP_USB_PHY
	select SAMSUNG_DEV_PWM
	help
	  Machine support for Samsung Mobile NURI Board.

config MACH_SMDK4X12
	bool "SMDK4X12 board"
	select CPU_EXYNOS4212
	select CPU_EXYNOS4412
	select S3C_DEV_WDT
	select S3C_DEV_RTC
	select S3C_DEV_HSMMC2
	select S3C_DEV_I2C1
	select S3C_DEV_I2C2
	select S3C_DEV_I2C3
	select S3C_DEV_I2C4
	select S3C_DEV_I2C5
	select S3C_DEV_I2C7
	select S5P_DEV_I2C_HDMIPHY
	select S5P_GPIO_INT
	select S5P_DEV_MFC
	select S5P_DEV_FIMG2D
	select S5P_DEV_FIMD0
	select S5P_DEV_FIMD_S5P
	select S5P_DEV_USB_EHCI
	select S5P_DEV_USBGADGET
	select S5P_DEV_USB_SWITCH
	select S5P_DEV_THERMAL
	select EXYNOS4_DEV_SYSMMU
	select EXYNOS_DEV_PD
	select EXYNOS4_SETUP_SDHCI
	select EXYNOS4_SETUP_FB_S5P
	select EXYNOS4_SETUP_FIMD0
	select EXYNOS4_SETUP_I2C1
	select EXYNOS4_SETUP_I2C2
	select EXYNOS4_SETUP_I2C3
	select EXYNOS4_SETUP_I2C4
	select EXYNOS4_SETUP_I2C5
	select EXYNOS4_SETUP_I2C7
	select EXYNOS4_SETUP_USB_PHY
	select EXYNOS4_SETUP_KEYPAD
	select EXYNOS4_SETUP_MFC
	select EXYNOS4_DEV_FIMC_LITE
	select SAMSUNG_DEV_ADC
	select SAMSUNG_DEV_BACKLIGHT
	select SAMSUNG_DEV_PWM
	select SAMSUNG_DEV_KEYPAD
	help
	  Machine support for Samsung SMDK4X12

config MACH_M032
	bool "MEIZU M032/M031 Board"
	select MX_SERIAL_TYPE
	select CPU_EXYNOS4212
	select CPU_EXYNOS4412
	select S3C_DEV_I2C2
	select S3C_DEV_I2C4
	select S5P_DEV_USB_SWITCH
	select EXYNOS4_SETUP_I2C2
	select EXYNOS4_SETUP_I2C4
	select LEDS_GPIO_REGISTER
	help
	  Machine support for Meizu M032/M031 SmartPhone based on EXYNOS4x12
	
config MACH_M030
	bool "MEIZU M030 Board"
	select MX_SERIAL_TYPE
	select CPU_EXYNOS4210
	help
	  Machine support for Meizu M030 SmartPhone based on EXYNOS4210

endmenu

menu "EXYNOS5 Machines"
	depends on ARCH_EXYNOS5

config MACH_SMDK5210
	bool "SMDK5210 board"
	select CPU_EXYNOS5210
	select S3C_DEV_HSMMC2
	select S3C_DEV_HSMMC3
	select S3C_DEV_I2C1
	select S3C_DEV_I2C2
	select S5P_DEV_DP
	select S5P_DEV_FIMD1
	select S5P_DEV_MFC
	select S5P_DEV_USB_EHCI
	select EXYNOS_DEV_PD
	select EXYNOS4_SETUP_DP
	select EXYNOS4_SETUP_FIMD
	select EXYNOS4_SETUP_I2C1
	select EXYNOS4_SETUP_I2C2
	select EXYNOS4_SETUP_MFC
	select EXYNOS4_SETUP_SDHCI
	select EXYNOS4_SETUP_USB_PHY
	select SAMSUNG_DEV_BACKLIGHT
	select SAMSUNG_DEV_PWM
	select S5P_DEV_I2C_HDMIPHY
	select EXYNOS_DEV_SS_UDC
	help
	  Machine support for Samsung SMDK5210

config MACH_SMDK5250
	bool "SMDK5250 board"
	select CPU_EXYNOS5250
	select S3C_DEV_RTC
	select S3C_DEV_WDT
	select S3C_DEV_HSMMC2
	select S3C_DEV_HSMMC3
	select S3C_DEV_I2C1
	select S3C_DEV_I2C4
	select S3C_DEV_I2C5
	select S3C_DEV_I2C7
	select S5P_DEV_DP
	select S5P_DEV_FIMD1
	select S5P_DEV_USB_EHCI
	select S5P_DEV_MFC
	select S5P_DEV_FIMG2D
	select S5P_DEV_USBGADGET
	select S5P_DEV_I2C_HDMIPHY
	select S5P_DEV_THERMAL
	select EXYNOS_DEV_PD
	select EXYNOS4_DEV_FIMC_LITE
	select EXYNOS4_SETUP_I2C1
	select EXYNOS4_SETUP_I2C4
	select EXYNOS4_SETUP_I2C5
	select EXYNOS4_SETUP_I2C7
	select EXYNOS4_SETUP_SDHCI
	select EXYNOS4_SETUP_DP
	select EXYNOS4_SETUP_FIMD
	select EXYNOS4_SETUP_USB_PHY
	select EXYNOS4_SETUP_MFC
	select EXYNOS5_DEV_AHCI
	select EXYNOS_DEV_SS_UDC
	select SAMSUNG_DEV_BACKLIGHT
	select SAMSUNG_DEV_PWM
	help
	  Machine support for Samsung SMDK5250
endmenu

config UBLOX_GPS
	bool "UART2 control for ublox gps support"
	depends on MX_SERIAL_TYPE
	help
         control uart2 to use for ublox gps

menu "MMC/SD slot setup"
depends on PLAT_S5P

comment "SELECT SYNOPSYS CONTROLLER INTERFACE DRIVER"

choice
	prompt "Select MSHC or DWMCI Support"
	depends on PLAT_S5P
	default EXYNOS4_DEV_DWMCI

config EXYNOS4_DEV_DWMCI
	bool "DWMCI"
	depends on PLAT_S5P
	help
	IF DWMCI is used, SDHC channel 0 is disabled.

config EXYNOS4_DEV_MSHC
	bool "MSHCI"
	depends on PLAT_S5P
	help
	IF MSHC is used, SDHC channel 0 is disabled.

endchoice

comment "Use 8-bit bus width"

config EXYNOS4_MSHC_8BIT
        bool "MSHC with 8-bit bus"
	depends on PLAT_S5P && EXYNOS4_DEV_MSHC
	default n
	help
	  IF MSHC uses 8-bit bus, SDHC channel 1 is disabled.

config EXYNOS4_SDHCI_CH0_8BIT
	bool "SDHC Channel 0 with 8-bit bus"
	depends on PLAT_S5P && !EXYNOS4_DEV_DWMCI && !EXYNOS4_DEV_MSHC
	default n
	help
	  Support HSMMC Channel 0 8-bit bus.
	  If selected, Channel 1 is disabled.

config EXYNOS4_SDHCI_CH2_8BIT
	bool "SDHC Channel 2 with 8-bit bus"
	depends on S3C_DEV_HSMMC2
	help
	  Support HSMMC Channel 2 8-bit bus.
	  If selected, Channel 3 is disabled.

comment "Use DDR"
	depends on PLAT_S5P && EXYNOS4_DEV_MSHC
config EXYNOS4_MSHC_DDR
        depends on PLAT_S5P && EXYNOS4_DEV_MSHC
	bool "MSHC with DDR mode"
	default n
	help
	  Enabling DDR(Dual Data Rate) mode.

endmenu

comment "Miscellaneous drivers"
config WAKEUP_ASSIST
	bool "Wakeup assist driver"
	depends on PM
	help
	  If the wakeup time is too slow, toggling POWER butten shortly causes to
	  ignore report of key event. It makes the android system not execute wake
	  up codes.

	  If selected, the wakeup assistant driver will report POWER key event
	  directly
endif

config EXYNOS_C2C
	bool "C2C device support"
	depends on SAMSUNG_C2C
	default y
	help
	  Add C2C device driver

config EXYNOS_DEV_C2C
	bool
	depends on EXYNOS_C2C
	default y

config EXYNOS5250_ABB_WA
	bool "ARM/INT ABB errata workaround"
	depends on CPU_EXYNOS5250 && CPU_FREQ && BUSFREQ_OPP
	default y
	help
	 Add W/A to fix ARM/INT ABB errata in EVT0
```
