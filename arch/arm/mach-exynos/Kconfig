## arch/arm/plat-s5p/Kconfig
```kconfig
# arch/arm/plat-s5p/Kconfig
#
# Copyright (c) 2009 Samsung Electronics Co., Ltd.
#		http://www.samsung.com/
#
# Licensed under GPLv2

config PLAT_S5P
	bool
	depends on (ARCH_S5P64X0 || ARCH_S5PC100 || ARCH_S5PV210 || ARCH_EXYNOS)
	default y
	select ARM_VIC if !ARCH_EXYNOS
	select ARM_GIC if ARCH_EXYNOS
	select NO_IOPORT
	select ARCH_REQUIRE_GPIOLIB
	select S3C_GPIO_TRACK
	select S5P_GPIO_DRVSTR
	select SAMSUNG_GPIOLIB_4BIT
	select S3C_GPIO_CFG_S3C64XX
	select S3C_GPIO_PULL_UPDOWN
	select S3C_GPIO_CFG_S3C24XX
	select PLAT_SAMSUNG
	select SAMSUNG_CLKSRC
	select SAMSUNG_IRQ_VIC_TIMER
	select SAMSUNG_IRQ_UART
	help
	  Base platform code for Samsung's S5P series SoC.

config S5P_EXT_INT
	bool
	help
	  Use the external interrupts (other than GPIO interrupts.)
	  Note: Do not choose this for S5P6440 and S5P6450.

config S5P_GPIO_INT
	bool
	help
	  Common code for the GPIO interrupts (other than external interrupts.)

config S5P_HRT
	bool
	select SAMSUNG_DEV_PWM
	help
	  Use the High Resolution timer support

comment "System MMU"

config S3C_DEV_FIMC
	bool
	depends on VIDEO_FIMC
	default y
	help
	  Compile in platform device definitions for FIMC

config S5P_DEV_FIMC0
	bool
	depends on VIDEO_SAMSUNG_S5P_FIMC
	default y
	help
	  Compile in platform device definitions for FIMC controller 0

config S5P_DEV_FIMC1
	bool
	depends on VIDEO_SAMSUNG_S5P_FIMC
	default y
	help
	  Compile in platform device definitions for FIMC controller 1

config S5P_DEV_FIMC2
	bool
	depends on VIDEO_SAMSUNG_S5P_FIMC
	default y
	help
	  Compile in platform device definitions for FIMC controller 2

config S5P_DEV_FIMC3
	bool
	depends on VIDEO_SAMSUNG_S5P_FIMC
	default y
	help
	  Compile in platform device definitions for FIMC controller 3

config S5P_DEV_I2C_HDMIPHY
	bool
	help
	  Compile in platform device definitions for I2C HDMIPHY controller

config S5P_DEV_TV
	bool
	depends on VIDEO_EXYNOS_TV
	default y
	help
	  Compile in platform device definition for TV interface

config S5P_DEV_MFC
	bool
	help
	  Compile in platform device definitions for MFC

config S5P_DEV_FIMD0
	bool
	help
	  Compile in platform device definitions for FIMD controller 0

config S5P_DEV_FIMD1
	bool
	help
	  Compile in platform device definitions for FIMD controller 1

config S5P_DEV_DP
	bool
	help
	  Compile in platform device definitions for DP controller

config S5P_DEV_TVOUT
	bool
	depends on VIDEO_TVOUT
	default y
	help
	  Compile in platform device definitions for TVOUT

config S5P_DEV_FIMG2D
	bool
	help
	  Compile in platform device definitions for FIMG2D controller

config S5P_DEV_ROTATOR
	bool
	help
	 Compile in platform device definitions for Rotator

config S5P_DEV_ONENAND
	bool
	help
	  Compile in platform device definition for OneNAND controller

config S5P_DEV_CSIS
	bool
	depends on VIDEO_FIMC_MIPI
	default y
	help
	  Compile in platform device definitions for MIPI-CSIS

config S5P_DEV_CSIS0
	bool
	depends on (VIDEO_S5P_MIPI_CSIS || VIDEO_EXYNOS_MIPI_CSIS)
	default y
	help
	  Compile in platform device definitions for MIPI-CSIS channel 0

config S5P_DEV_CSIS1
	bool
	depends on (VIDEO_S5P_MIPI_CSIS || VIDEO_EXYNOS_MIPI_CSIS)
	default y
	help
	  Compile in platform device definitions for MIPI-CSIS channel 1

config S5P_DEV_JPEG
	bool
	default y
	help
	  Compile in platform device definitions for JPEG

config S5P_DEV_USB_EHCI
	bool
	help
	  Compile in platform device definition for USB EHCI

config S5P_DEV_FIMD_S5P
	bool
	help
	  Compile in platform device definitions for FIMD controller

config S5P_DEV_USBGADGET
	bool
	help
	  compile in platform device definitions for USB-GADGET

config S5P_DEV_USB_SWITCH
	bool
	help
	  compile in platform device definitions for USB-SWITCH

config S5P_DEV_DSIM
	bool
	help
	  Compile in platform device definitions for MIPI-DSIM

config S5P_SETUP_MIPIPHY
	bool
	default n
	help
	  Compile in common setup code for MIPI-CSIS and MIPI-DSIM devices

config S5P_MEM_CMA
	bool "Fixed memory through CMA"
	select CMA
	help
	  Use CMA(Contiguous memory allocator) to reserve machine specific memory.

config S5P_DEV_THERMAL
	bool
	help
	  Compile in platform device definitions for THERMAL management unit.

config S5P_DEV_ACE
	bool
	help
	  Compile in common setup code for Crypto Engine devices.
```

## drivers/cpufreq/Kconfig.exynos
```kconfig
config EXYNOS_CPUFREQ
	bool "SAMSUNG EXYNOS 4210/4X12 CPU Frequency driver"
	default y
	help
	 EXYNOS4 CPU Frequency driver.

if EXYNOS_CPUFREQ

config EXYNOS4210_CPUFREQ
	bool "Exynos 4210 cpufreq support"
	depends on CPU_EXYNOS4210
	help
	  Exynos4210 cpufreq support

config EXYNOS4X12_CPUFREQ
	bool "Exynos 4212/4412 cpufreq support"
	depends on CPU_EXYNOS4212
	help
	  Exynos4412/4212 cpufreq support

endif
```

## drivers/gpu/arm/mali/Kconfig
```kconfig
#
## S3C Multimedia Mali configuration
##
#
# For Mali
config VIDEO_MALI400MP
	bool "Enable MALI integration"
	depends on VIDEO_SAMSUNG
	default y
	---help---
                This enables MALI integration in the multimedia device driver

choice
depends on VIDEO_MALI400MP
prompt "MALI MEMORY OPTION"
default MALI_OSMEM_ONLY
config MALI_DED_ONLY
  bool "mali dedicated memory only"
   ---help---
       This enables MALI dedicated memory only option
config MALI_DED_MMU
  bool "mali dedicated memory with mmu enable"
   ---help---
       This enables MALI dedicated memory with mmu enable option
config MALI_OSMEM_ONLY
   bool "mali OS memory only"
   ---help---
       This enables MALI OS memory only option
config MALI_DED_OSMEM
   bool "mali dedicated memory and OS memory"
   ---help---
       This enables MALI dedicated memory and OS memory option

endchoice
config MALI_MEM_SIZE
int "Dedicated Memory Size"
   depends on VIDEO_MALI400MP && (MALI_DED_ONLY || MALI_DED_MMU || MALI_DED_OSMEM)
   default "128"
   ---help---
       This value is dedicated memory size of Mali GPU(unit is MByte).


# For DEBUG
config VIDEO_MALI400MP_DEBUG
	bool "Enables debug messages"
	depends on VIDEO_MALI400MP
	default n
	help
	  This enables Mali driver debug messages.

config VIDEO_MALI400MP_STREAMLINE_PROFILING
	bool "Enables mali streamline profiling"
	depends on VIDEO_MALI400MP
	default n
	help
	  This enables Mali streamline profiling.

config VIDEO_MALI400MP_DVFS
	bool "Enables DVFS"
	depends on VIDEO_MALI400MP && PM 
	default y
	help
	  This enables Mali driver DVFS.
```

## drivers/gpu/vithar/Kconfig
```kconfig
menuconfig VITHAR
	tristate "Enable Vithar DDK"
	default n
	help
	  Choose this option to enable 3D rendering with vithar DDK.

config VITHAR_DEVICE_NODE_CREATION_IN_RUNTIME
	bool "Enable runtime device file creation by using UDEV"
	depends on VITHAR
	default y
	help
	  Choose this option to create device file under dev folder in runtime. Must be yes for Android.

config VITHAR_RT_PM
	bool "Enable Runtime power management"
	depends on VITHAR
	default n
	help
	  Choose this option to enable runtime power management on vithar DDK.

config VITHAR_DVFS
	bool "Enable DVFS"
	depends on VITHAR
	default n
	help
	  Choose this option to enable DVFS on vithar DDK.

config VITHAR_ION
	bool "Enable ION"
	depends on VITHAR
	default n
	help
	  Choose this option to enable ION to translate fd to sequre ID.
```

## drivers/iommu/Kconfig
```kconfig
# IOMMU_API always gets selected by whoever wants it.
config IOMMU_API
	bool

menuconfig IOMMU_SUPPORT
	bool "IOMMU Hardware Support"
	default y
	---help---
	  Say Y here if you want to compile device drivers for IO Memory
	  Management Units into the kernel. These devices usually allow to
	  remap DMA requests and/or remap interrupts from other devices on the
	  system.

if IOMMU_SUPPORT

# MSM IOMMU support
config MSM_IOMMU
	bool "MSM IOMMU Support"
	depends on ARCH_MSM8X60 || ARCH_MSM8960
	select IOMMU_API
	help
	  Support for the IOMMUs found on certain Qualcomm SOCs.
	  These IOMMUs allow virtualization of the address space used by most
	  cores within the multimedia subsystem.

	  If unsure, say N here.

config IOMMU_PGTABLES_L2
	def_bool y
	depends on MSM_IOMMU && MMU && SMP && CPU_DCACHE_DISABLE=n

# OMAP IOMMU support
config OMAP_IOMMU
	bool "OMAP IOMMU Support"
	depends on ARCH_OMAP
	select IOMMU_API

config OMAP_IOVMM
	tristate "OMAP IO Virtual Memory Manager Support"
	depends on OMAP_IOMMU

config OMAP_IOMMU_DEBUG
       tristate "Export OMAP IOMMU/IOVMM internals in DebugFS"
       depends on OMAP_IOVMM && DEBUG_FS
       help
         Select this to see extensive information about
         the internal state of OMAP IOMMU/IOVMM in debugfs.

         Say N unless you know you need this.

# EXYNOS IOMMU support
config EXYNOS_IOMMU
	bool "Exynos IOMMU Support"
	depends on ARCH_EXYNOS && EXYNOS4_DEV_SYSMMU
	select IOMMU_API
	select ARM_DMA_USE_IOMMU
	help
	  Support for the IOMMU(System MMU) of Samsung Exynos application
	  processor family. This enables H/W multimedia accellerators to see
	  non-linear physical memory chunks as a linear memory in their
	  address spaces

	  If unsure, say N here.

endif # IOMMU_SUPPORT
```

## drivers/media/video/exynos/fimc-lite/Kconfig
```kconfig
config VIDEO_EXYNOS_FIMC_LITE
	bool "Exynos Camera Interface(FIMC-Lite) driver"
	depends on VIDEO_EXYNOS && (ARCH_EXYNOS4 || ARCH_EXYNOS5)
	select MEDIA_EXYNOS
	default n
	help
	  This is a v4l2 driver for exynos camera interface device.
```

## drivers/media/video/samsung/Kconfig
```kconfig
config VIDEO_SAMSUNG
	bool "Samsung Multimedia Devices"
	depends on VIDEO_CAPTURE_DRIVERS && VIDEO_V4L2
	select VIDEO_FIXED_MINOR_RANGES
	default n
	help
	  This is a representative video4linux configuration for Samsung multimedia devices.

config VIDEO_SAMSUNG_V4L2
	bool "V4L2 API for digital camera to be contributed by samsung"
	depends on VIDEO_DEV && VIDEO_SAMSUNG
	default n
	help
	  This feature is for new V4L2 APIs all about digital camera

if CPU_EXYNOS4210 || CPU_EXYNOS4212
	source "drivers/media/video/samsung/fimc/Kconfig"
	source "drivers/media/video/samsung/tvout/Kconfig"
	source "drivers/media/video/samsung/mfc5x/Kconfig"
endif


config VIDEO_FIMG2D
	bool
	depends on VIDEO_SAMSUNG
	default n

config VIDEO_FIMG2D_DEBUG
	bool
	depends on VIDEO_FIMG2D
	default n

source "drivers/media/video/samsung/fimg2d3x/Kconfig"
source "drivers/media/video/samsung/fimg2d4x/Kconfig"
source "drivers/media/video/samsung/rotator/Kconfig"
source "drivers/media/video/samsung/jpeg_mx/Kconfig"

if CPU_EXYNOS4210
	source "drivers/media/video/samsung/jpeg/Kconfig"
endif

if CPU_EXYNOS4212 || CPU_EXYNOS5250
	source "drivers/media/video/samsung/jpeg_v2x/Kconfig"
endif

if VIDEO_SAMSUNG
comment "Reserved memory configurations"
config VIDEO_SAMSUNG_MEMSIZE_FIMC0
	int "Memory size in kbytes for FIMC0"
	depends on (VIDEO_FIMC || VIDEO_SAMSUNG_S5P_FIMC) && !MX_SERIAL_TYPE
	default "5120"

config VIDEO_SAMSUNG_MEMSIZE_FIMC1
	int "Memory size in kbytes for FIMC1"
	depends on (VIDEO_FIMC || VIDEO_SAMSUNG_S5P_FIMC) && !MX_SERIAL_TYPE
	default "5120"

config VIDEO_SAMSUNG_MEMSIZE_FIMC2
	int "Memory size in kbytes for FIMC2"
	depends on (VIDEO_FIMC || VIDEO_SAMSUNG_S5P_FIMC) && !MX_SERIAL_TYPE
	default "5120"

config VIDEO_SAMSUNG_MEMSIZE_FIMC3
	int "Memory size in kbytes for FIMC3"
	depends on (VIDEO_FIMC || VIDEO_SAMSUNG_S5P_FIMC) && !MX_SERIAL_TYPE
	default "5120"

config VIDEO_SAMSUNG_MEMSIZE_MFC
	int "Memory size in kbytes for MFC"
	depends on ((VIDEO_MFC5X) && (VIDEO_MFC_MEM_PORT_COUNT = 1)) && !MX_SERIAL_TYPE
	default "65536"

config VIDEO_SAMSUNG_MEMSIZE_MFC0
	int "Memory size in kbytes for MFC port0"
	depends on ((VIDEO_MFC5X) && (!VIDEO_MFC_MEM_PORT_COUNT = 1)) && !MX_SERIAL_TYPE
	default "41984"

config VIDEO_SAMSUNG_MEMSIZE_MFC1
	int "Memory size in kbytes for MFC port1"
	depends on ((VIDEO_MFC5X) && (!VIDEO_MFC_MEM_PORT_COUNT = 1)) && !MX_SERIAL_TYPE
	default "41984"

config VIDEO_SAMSUNG_MEMSIZE_JPEG
	int "Memory size in kbytes for JPEG"
	depends on (VIDEO_JPEG || VIDEO_JPEG_V2X || VIDEO_JPEG_MX) && !MX_SERIAL_TYPE
	default "31744"

config VIDEO_SAMSUNG_MEMSIZE_FIMG2D
	int "Memory size in kbytes for FIMG2D"
	depends on (VIDEO_FIMG2D4X || VIDEO_FIMG2D3X) && !MX_SERIAL_TYPE
	default "8192"
	
endif
```

## drivers/media/video/samsung/jpeg_mx/Kconfig
```kconfig
#
# Configuration for JPEG
#

config VIDEO_JPEG_MX
	bool "Samsung JPEG driver for MX"
	depends on VIDEO_SAMSUNG
	default n
	depends on VIDEO_DEV && VIDEO_V4L2
	select V4L2_MEM2MEM_DEV
	---help---
	  This is a Samsung JPEG driver(Codec and V2.x) for MX 

config VIDEO_JPEG_DEBUG
	bool "print JPEG debug message"
	depends on VIDEO_JPEG_MX
	default n
```

## drivers/media/video/samsung/jpeg_v2x/Kconfig
```kconfig
#
# Configuration for JPEG
#

config VIDEO_JPEG_V2X
	bool "Samsung JPEG_v2.x driver"
	depends on VIDEO_SAMSUNG
	default n
	depends on VIDEO_DEV && VIDEO_V4L2
	depends on !VIDEO_JPEG_MX
	select V4L2_MEM2MEM_DEV
	---help---
	  This is a Samsung JPEG H/W driver for V2.x

config VIDEO_JPEG_DEBUG
	bool "print JPEG debug message"
	depends on VIDEO_JPEG_V2X
	default n
```

## drivers/media/video/samsung/rotator/Kconfig
```kconfig
#
# Configuration for rotator
#

config VIDEO_ROTATOR
	bool "Samsung Image Rotator Driver" 
	depends on VIDEO_SAMSUNG
	default n
	---help---
	  This is a Rotator for Samsung S5PV210
```

## drivers/motor/Kconfig
```kconfig
#
#
#
menuconfig VIBRATOR
	tristate "Vibrator"
	default y
	help
	  Say Y to enable Vibrator support.

if VIBRATOR

config MOTOR_DRV_MAX77665
	tristate "Maxim MAX77665 motor"
	default y
	depends on MFD_MAX77665
	help
	  If you say yes here you will get support for the
	  motor of Maxim MAX77665 PMIC.

config MOTOR_DRV_MAX8997
	tristate "Maxim MAX8997 motor"
	default y
	depends on MFD_MAX8997
	help
	  If you say yes here you will get support for the
	  motor of Maxim MAX8997 PMIC.

endif
```

## drivers/mxphone/Kconfig
```kconfig
#
#
#

menuconfig MEIZU_PHONE
	tristate "Meizu Phone Interface"
	default n
	---help---
		meizu phone interface.
if MEIZU_PHONE

config XMM6260_MODEM
	tristate "XMM6260 Modem support"
	help
	  Say Y here to enable XMM6260 modem control support.
	  
config XMM6260_ACM_CLASS
	bool
	default y
	depends on XMM6260_MODEM && USB_EHCI_HCD

config XMM6260_ENUM_SYNC
	bool "Sync enumerate modem device after sleep"
	default n
	depends on XMM6260_ACM_CLASS
	
  config XMM6260_MODEM_TTY
	tristate "XMM6260 Modem virtual tty support"
	depends on XMM6260_ACM_CLASS
	help
	  Say Y here to enable XMM6260 modem virtual tty device support.

config XMM6260_MODEM_NET
	tristate "XMM6260 Modem virtual net support"
	depends on  NET && XMM6260_ACM_CLASS
	help
	  Say Y here to enable XMM6260 modem virtual net device support.

endif # MEIZU_PHONE
```
